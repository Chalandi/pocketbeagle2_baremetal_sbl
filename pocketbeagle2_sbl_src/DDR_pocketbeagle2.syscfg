/**
 * @cliArgs --device "AM62x" --part "Default" --package "ALW" --product "Processor_DDR_Config@0.10.32"
 * @versions {"tool":"1.24.0+4110"}
 */

/**
 * Import the modules used in this configuration.
 */
const DDRSS = scripting.addModule("/DDRSS");

/**
 * Write custom configuration values to the imported modules.
 */
DDRSS.ddr4.$name                         = "sitara_ddr4_DDRSS_DDR40";
DDRSS.ddr4.system_cfg_dram_density       = 4;
DDRSS.ddr4.config_dram_tDLLK_tCK         = 1024;
DDRSS.ddr4.config_dram_tWR_CRC_DM_tCK    = 5;
DDRSS.ddr4.config_dram_tWTR_S_CRC_DM_tCK = 5;
DDRSS.ddr4.config_dram_tCCD_L_tCK        = 5;
